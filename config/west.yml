## config/west.yml
```yaml
manifest:
  remotes:
    - name: morou
      url-base: https://github.com/morou
  projects:
    - name: zmk
      remote: morou
      revision: zen-v1+v2-debug
      import: app/west.yml
  self:
    path: config
```
